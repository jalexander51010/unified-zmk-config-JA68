/ {
    chosen { zmk,keyboard = &kb; };

    kb: keyboard {
        compatible = "zmk,keyboard-matrix";

        matrix {
            rows = <5>;
            columns = <15>;

            /* Rows (bare bus wires) */
            row-gpios = <
                &gpio0 6  GPIO_ACTIVE_LOW
                &gpio0 8  GPIO_ACTIVE_LOW
                &gpio0 17 GPIO_ACTIVE_LOW
                &gpio0 20 GPIO_ACTIVE_LOW
                &gpio0 22 GPIO_ACTIVE_LOW
            >;

            /* Columns (blue bus wires) */
            col-gpios = <
                &gpio0 24 GPIO_ACTIVE_LOW
                &gpio1 0  GPIO_ACTIVE_LOW
                &gpio0 11 GPIO_ACTIVE_LOW
                &gpio1 4  GPIO_ACTIVE_LOW
                &gpio1 6  GPIO_ACTIVE_LOW
                &gpio0 31 GPIO_ACTIVE_LOW
                &gpio0 29 GPIO_ACTIVE_LOW
                &gpio0 2  GPIO_ACTIVE_LOW
                &gpio1 15 GPIO_ACTIVE_LOW
                &gpio1 13 GPIO_ACTIVE_LOW
                &gpio1 11 GPIO_ACTIVE_LOW
                &gpio0 10 GPIO_ACTIVE_LOW
                &gpio1 1  GPIO_ACTIVE_LOW
                &gpio1 2  GPIO_ACTIVE_LOW
                &gpio1 7  GPIO_ACTIVE_LOW
            >;
        };
    };
};

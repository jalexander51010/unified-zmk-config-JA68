default_layer {
  bindings = <
    &mo 1            &kp KP_DIVIDE   &kp KP_MULTIPLY   &kp KP_MINUS
    &kp KP_N7        &kp KP_N8       &kp KP_N9         &none
    &kp KP_N4        &kp KP_N5       &kp KP_N6         &kp KP_PLUS
    &kp KP_N1        &kp KP_N2       &kp KP_N3         &none
    &kp KP_N0        &none           &kp KP_DOT        &kp KP_ENTER
  >;
};

fn_layer {
  bindings = <
    &kp KP_NUMLOCK   &sys_reset      &bootloader       &kp C_VOL_DN
    &kp C_PREV       &kp C_PP        &kp C_NEXT        &none
    &bt BT_SEL 3     &bt BT_SEL 4    &bt BT_NXT        &kp C_VOL_UP
    &bt BT_SEL 0     &bt BT_SEL 1    &bt BT_SEL 2      &none
    &kp C_MUTE       &none           &bt BT_CLR        &kp C_PP
  >;
};
